	LIST P=16F877A
	#INCLUDE <P16F877A.INC>
	SAYICI1 EQU 0X20
	SAYICI2 EQU 0X21
	LCD_DEG EQU 0X22
	DEG1 EQU 0X23
	DEG2 EQU 0X24
	SAYICI_KAYDIRMA EQU 0X25
	ORG 0X00
	GOTO ANA_METOT

ANA_METOT
	BANKSEL TRISB
	CLRF TRISB
	BANKSEL PORTB
	CLRF PORTB
	
	CLRF DEG1
	CLRF DEG2

	CALL LCD_AYARLAR
	CALL LCD_KARAKTERLER

;SATIR_1
;	MOVLW H'80'
;	CALL LCD_KOMUT_YAZDIR
;AD
;	MOVF DEG1,W
;	CALL TABLO1
;	XORLW 0X00
;	BTFSC STATUS,Z
;	GOTO SATIR_2
;	CALL LCD_KARAKTER_YAZDIR
;	INCF DEG1,F
;	GOTO AD
;
;SATIR_2
;	MOVLW H'C0'
;	CALL LCD_KOMUT_YAZDIR
;SOYAD
;	MOVF DEG2,W
;	CALL TABLO2
;	XORLW 0X00
;	BTFSC STATUS,Z
;	GOTO KONTROL
;	CALL LCD_KARAKTER_YAZDIR
;	INCF DEG2,F
;	GOTO SOYAD
;
;	CALL SAYDIR
;	RETURN

SAYDIR 
	MOVLW 0X00
	MOVWF SAYICI_KAYDIRMA

KAYDIRMA_METOT
	INCF SAYICI_KAYDIRMA,F
	MOVF SAYICI_KAYDIRMA,W
	SUBLW H'05'
	BTFSC STATUS,Z
	RETURN
	CALL LCD_KAYDIR
	GOTO KAYDIRMA_METOT

LCD_KAYDIR
	MOVLW H'1C'
	CALL LCD_KOMUT_YAZDIR
	RETURN

LCD_KOMUT_YAZDIR
	MOVWF LCD_DEG
	SWAPF LCD_DEG,W
	ANDLW 0X0F
	MOVWF PORTB
	
	BCF PORTB,4
	BSF PORTB,5
;	CALL GECIKME
	BCF PORTB,5

	MOVF LCD_DEG,W
	ANDLW 0X0F
	MOVWF PORTB
	
	BCF PORTB,4
	BSF PORTB,5
;	CALL GECIKME
	BCF PORTB,5

	RETURN

LCD_KARAKTER_YAZDIR
	MOVWF LCD_DEG
	SWAPF LCD_DEG,W
	ANDLW 0X0F
	MOVWF PORTB

	BSF PORTB,4
	BSF PORTB,5
;	CALL GECIKME
	BCF PORTB,5

	MOVF LCD_DEG,W
	ANDLW 0X0F
	MOVWF PORTB

	BSF PORTB,4
	BSF PORTB,5
;	CALL GECIKME
	BCF PORTB,5

	RETURN
;
;GECIKME
;	MOVLW 0XFF
;	MOVWF SAYICI1
;
;TEKRAR1
;	MOVLW 0XFF
;	MOVWF SAYICI2
;
;TEKRAR2
;	DECFSZ SAYICI2,F
;	GOTO TEKRAR2
;	DECFSZ SAYICI1,F
;	GOTO TEKRAR1
;	RETURN

LCD_AYARLAR
	MOVLW H'02'
	CALL LCD_KOMUT_YAZDIR
	
	MOVLW H'0C'
	CALL LCD_KOMUT_YAZDIR

	MOVLW H'28'
	CALL LCD_KOMUT_YAZDIR

	RETURN

LCD_KARAKTERLER
	MOVLW A'n'
	CALL LCD_KARAKTER_YAZDIR

	MOVLW A'i'
	CALL LCD_KARAKTER_YAZDIR

	MOVLW A'l'
	CALL LCD_KARAKTER_YAZDIR

	MOVLW A'a'
	CALL LCD_KARAKTER_YAZDIR

	MOVLW A'y'
	CALL LCD_KARAKTER_YAZDIR
	
	CALL SATIR2

	MOVLW A'a'
	CALL LCD_KARAKTER_YAZDIR

	MOVLW A'l'
	CALL LCD_KARAKTER_YAZDIR

	MOVLW A't'
	CALL LCD_KARAKTER_YAZDIR

	MOVLW A'u'
	CALL LCD_KARAKTER_YAZDIR

	MOVLW A'g'
	CALL LCD_KARAKTER_YAZDIR

	CALL SAYDIR

	RETURN

SATIR2
	MOVLW H'C0'
	CALL LCD_KOMUT_YAZDIR
	RETURN

TABLO1
	ADDWF PCL,F
	RETLW 'N'
	RETLW 'I'
	RETLW 'L'
	RETLW 'A'
	RETLW 'Y'
	RETLW 0X00

TABLO2
	ADDWF PCL,F
	RETLW 'A'
	RETLW 'L'
	RETLW 'T'
	RETLW 'U'
	RETLW 'G'
	RETLW 0X00

KONTROL
	GOTO KONTROL
	
END